## board/xiaomi/lavender/Kconfig
```kconfig
if TARGET_XIAOMI_LAVENDER

# Define CONFIG_SYS_BOARD="board" to compile
#        board/<board>/*
#        board/<vendor>/<board>/* (if CONFIG_SYS_VENDOR is defined)
config SYS_BOARD
	default "lavender"
	help
	  Xiaomi Redmi Note 7 is a mid-range mobile phone based
	  on Qualcomm Sanpdragon 660 SoC.

# Define CONFIG_SYS_VENDOR="vendor" to compile
#        board/<vendor>/common/*
#        board/<vendor>/<board>/*
config SYS_VENDOR
	default "xiaomi"

# Define CONFIG_SYS_SOC="soc" to compile
#        arch/<arch>/cpu/<cpu>/<soc>
config SYS_SOC
	default "sdm660"

# Define CONFIG_SYS_CONFIG_NAME="target" to include: include/configs/<target>.h
config SYS_CONFIG_NAME
	string "Board configuration name"
	default "xiaomi-lavender"
	help
	  This option contains information about board configuration name.
	  Based on this option include/configs/<CONFIG_SYS_CONFIG_NAME>.h header
	  will be used for board configuration.

endif
```

## configs/lavender_defconfig
```kconfig
CONFIG_ARM=y
CONFIG_SKIP_LOWLEVEL_INIT=y
CONFIG_POSITION_INDEPENDENT=y
CONFIG_ARM_SMCCC=y
CONFIG_ARCH_SNAPDRAGON=y
CONFIG_TEXT_BASE=0x40090000
CONFIG_SYS_MALLOC_LEN=0x81f000
CONFIG_NR_DRAM_BANKS=2
CONFIG_DEFAULT_DEVICE_TREE="sdm660-xiaomi-lavender"
CONFIG_TARGET_XIAOMI_LAVENDER=y
CONFIG_PRE_CON_BUF_ADDR=0xa0000000
CONFIG_DEBUG_UART_BASE=0xc170000
CONFIG_DEBUG_UART_CLOCK=115200
CONFIG_IDENT_STRING=" \nQualcomm SDM660 Xiaomi Redmi Note 7 (lavender)"
# CONFIG_PSCI_RESET is not set
CONFIG_SYS_LOAD_ADDR=0x40090000
CONFIG_DEBUG_UART=y
CONFIG_DISTRO_DEFAULTS=y
CONFIG_SD_BOOT=y
CONFIG_BOOTDELAY=3
CONFIG_BOOTCOMMAND="setenv stdout serial,vidconsole; setenv stderr serial,vidconsole; coninfo; version; bdinfo; pinmux list; pinmux dev pinctrl@3100000; part types; mmc info; part list mmc 0"
CONFIG_USE_PREBOOT=y
CONFIG_SAVE_PREV_BL_FDT_ADDR=y
CONFIG_SAVE_PREV_BL_INITRAMFS_START_ADDR=y
CONFIG_LOGLEVEL=7
CONFIG_PRE_CONSOLE_BUFFER=y
CONFIG_SYS_DEVICE_NULLDEV=y
CONFIG_LOG=y
CONFIG_LOG_MAX_LEVEL=7
CONFIG_BOARD_TYPES=y
CONFIG_DISPLAY_BOARDINFO_LATE=y
CONFIG_CMD_BOOTZ=y
CONFIG_CMD_BOOTMENU=y
CONFIG_CMD_ADTIMG=y
CONFIG_CMD_MEMINFO=y
CONFIG_CMD_GPIO=y
CONFIG_CMD_MMC=y
CONFIG_CMD_MMC_SWRITE=y
CONFIG_CMD_POWEROFF=y
CONFIG_CMD_READ=y
CONFIG_CMD_PMIC=y
CONFIG_CMD_EVENT=y
# CONFIG_ISO_PARTITION is not set
CONFIG_PARTITION_TYPE_GUID=y
CONFIG_ENV_SOURCE_FILE="lavender"
CONFIG_SYS_RELOC_GD_ENV_ADDR=y
# CONFIG_NET is not set
# CONFIG_DM_STDIO is not set
CONFIG_CLK=y
CONFIG_MSM_GPIO=y
CONFIG_QCOM_PMIC_GPIO=y
CONFIG_DM_KEYBOARD=y
CONFIG_MMC_HS400_ES_SUPPORT=y
CONFIG_MMC_HS400_SUPPORT=y
CONFIG_MMC_SDHCI=y
CONFIG_MMC_SDHCI_MSM=y
CONFIG_PINCTRL=y
CONFIG_PINCONF=y
CONFIG_DM_PMIC=y
CONFIG_PMIC_QCOM=y
# CONFIG_REQUIRE_SERIAL_CONSOLE is not set
CONFIG_DEBUG_UART_ANNOUNCE=y
CONFIG_MSM_SERIAL=y
CONFIG_SPMI_MSM=y
CONFIG_VIDEO=y
CONFIG_CONSOLE_ROTATION=y
CONFIG_CONSOLE_TRUETYPE=y
CONFIG_CONSOLE_TRUETYPE_SIZE=40
CONFIG_SYS_WHITE_ON_BLACK=y
# CONFIG_PANEL is not set
# CONFIG_CONSOLE_TRUETYPE_NIMBUS is not set
CONFIG_CONSOLE_TRUETYPE_ANKACODER=y
CONFIG_VIDEO_SIMPLE=y
```

## drivers/pinctrl/qcom/Kconfig
```kconfig
if ARCH_SNAPDRAGON

config PINCTRL_QUALCOMM
	bool "Qualcomm pin control (TLMM) drivers"
	depends on ARCH_SNAPDRAGON && PINCTRL_GENERIC
	default y
	help
	  Enable support for pin controllers (Top Level Mode Multiplexers)
	  in Qualcomm SoCs. This option will automatically build support
	  for currently selected target SoC.

endif
```
